/* 指定输出文件的格式为 32 位 ELF，适用于 i386 架构 */
OUTPUT_FORMAT("elf32-i386", "elf32-i386", "elf32-i386")

/* 指定目标架构为 i386 */
OUTPUT_ARCH(i386)

/* 指定程序的入口点为 start 标签 */
ENTRY(start)

/* 定义各个段的布局 */
SECTIONS {
    /* 将代码加载到 1MB 的内存位置，这是多引导规范的要求 */
    . = 1M;

    /* 定义代码段 */
    .text : {
        /* 将所有目标文件中的 .multiboot_header 段内容合并到这里 */
        /* 这是多引导头，必须位于代码段的开头 */
        *(.multiboot_header)

        /* 对齐到 8 字节边界，确保后续代码对齐 */
        . = ALIGN(8);

        /* 将所有目标文件中的 .text 段内容合并到这里 */
        /* 这是实际的代码部分 */
        *(.text)
    }
}